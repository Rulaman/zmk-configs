## config/boards/shields/16xPrototype/Kconfig.defconfig
```kconfig
if SHIELD_16xPROTOTYPE

config ZMK_KEYBOARD_NAME
    default "16xPrototype"

config ZMK_SPLIT_ROLE_CENTRAL
    default n

# Enable pinctrl
CONFIG_PINCTRL=n

endif
```

## config/boards/shields/EncoderTest16er/Kconfig.defconfig
```kconfig
if SHIELD_Encoder-Test-16er

config ZMK_KEYBOARD_NAME
    default "EncoderTest16er"

config ZMK_SPLIT_ROLE_CENTRAL
    default n

# Enable pinctrl
CONFIG_PINCTRL=n

endif
```

## config/boards/shields/EncoderTest16er/Kconfig.shield
```kconfig
config SHIELD_Encoder-Test-16er
    def_bool $(shields_list_contains,Encoder-Test-16er)
```

## config/boards/shields/MouseTest-Blackpill/Kconfig.defconfig
```kconfig
if SHIELD_MouseTestBlackpill

config ZMK_KEYBOARD_NAME
    default "MouseTest-BP"

config SYSTEM_WORKQUEUE_STACK_SIZE
    default 8192

endif
```

## config/boards/shields/MouseTest-Blackpill/Kconfig.shield
```kconfig
config SHIELD_MouseTestBlackpill
    def_bool $(shields_list_contains,MouseTest-Blackpill)
```

## config/boards/shields/tworows/Kconfig.defconfig
```kconfig
if SHIELD_TWOROWS

config ZMK_KEYBOARD_NAME
    default "tworows"

config ZMK_SPLIT_ROLE_CENTRAL
    default n

# Enable pinctrl
CONFIG_PINCTRL=n

endif
```
